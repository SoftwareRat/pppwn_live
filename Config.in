## br2-external/Config.in
```kconfig
menu "PPPwn Live ISO packages"

source "$BR2_EXTERNAL_PPPWN_PATH/package/pppwn-cpp/Config.in"
source "$BR2_EXTERNAL_PPPWN_PATH/package/pppwn-stage1/Config.in"
source "$BR2_EXTERNAL_PPPWN_PATH/package/pppwn-stage2/Config.in"

endmenu
```

## br2-external/package/pppwn-cpp/Config.in
```kconfig
config BR2_PACKAGE_PPPWN_CPP
	bool "pppwn-cpp"
	depends on BR2_TOOLCHAIN_HAS_THREADS
	depends on BR2_INSTALL_LIBSTDCPP
	depends on BR2_TOOLCHAIN_GCC_AT_LEAST_7
	select BR2_PACKAGE_HOST_CMAKE
	help
	  PPPwn C++ implementation for PS4 exploit execution.
	  
	  https://github.com/xfangfang/PPPwn_cpp
```

## br2-external/package/pppwn-stage1/Config.in
```kconfig
config BR2_PACKAGE_PPPWN_STAGE1
	bool "pppwn-stage1"
	help
	  PPPwn stage1 payloads for various PS4 firmware versions.
	  
	  https://github.com/TheOfficialFloW/PPPwn
```

## br2-external/package/pppwn-stage2/Config.in
```kconfig
config BR2_PACKAGE_PPPWN_STAGE2
	bool "pppwn-stage2"
	help
	  PPPwn stage2 payloads for various PS4 firmware versions.
	  
	  https://github.com/TheOfficialFloW/PPPwn
```

## configs/pppwn_defconfig
```kconfig
# PPPwn Live ISO Buildroot configuration
# Target x64 architecture for minimal live system

# Architecture
BR2_x86_64=y

# Toolchain
BR2_TOOLCHAIN_BUILDROOT_GLIBC=y
BR2_TOOLCHAIN_BUILDROOT_CXX=y

# System configuration
BR2_TARGET_GENERIC_HOSTNAME="pppwnlive"
BR2_TARGET_GENERIC_ISSUE="PPPwn Live System - PS4 Exploit Ready"
BR2_TARGET_GENERIC_PASSWD_SHA256=y
BR2_ROOTFS_DEVICE_CREATION_DYNAMIC_EUDEV=y
BR2_TARGET_GENERIC_ROOT_PASSWD=""
BR2_TARGET_GENERIC_GETTY_PORT="console"
BR2_TARGET_GENERIC_GETTY_BAUDRATE_115200=y

# Kernel
BR2_LINUX_KERNEL=y
BR2_LINUX_KERNEL_CUSTOM_VERSION=y
BR2_LINUX_KERNEL_CUSTOM_VERSION_VALUE="6.6.69"
BR2_LINUX_KERNEL_USE_CUSTOM_CONFIG=y
BR2_LINUX_KERNEL_CUSTOM_CONFIG_FILE="$(BR2_EXTERNAL_PPPWN_PATH)/configs/linux.config"
BR2_LINUX_KERNEL_INSTALL_TARGET=y

# Filesystem
BR2_TARGET_ROOTFS_CPIO=y
BR2_TARGET_ROOTFS_CPIO_GZIP=y
BR2_TARGET_ROOTFS_ISO9660=y
BR2_TARGET_ROOTFS_ISO9660_INITRD="$(BINARIES_DIR)/rootfs.cpio.gz"
BR2_TARGET_ROOTFS_ISO9660_BOOT_MENU="$(BR2_EXTERNAL_PPPWN_PATH)/configs/isolinux.cfg"

# Bootloader
BR2_TARGET_SYSLINUX=y
BR2_TARGET_SYSLINUX_ISOLINUX=y

# System packages
BR2_PACKAGE_BUSYBOX=y
BR2_PACKAGE_BUSYBOX_CONFIG="$(BR2_EXTERNAL_PPPWN_PATH)/configs/busybox.config"
BR2_PACKAGE_DHCPCD=y
BR2_PACKAGE_ETHTOOL=y
BR2_PACKAGE_IPROUTE2=y
BR2_PACKAGE_IPTABLES=y

# PPPwn packages
BR2_PACKAGE_PPPWN_CPP=y
BR2_PACKAGE_PPPWN_STAGE1=y
BR2_PACKAGE_PPPWN_STAGE2=y

# Overlay and scripts
BR2_ROOTFS_OVERLAY="$(BR2_EXTERNAL_PPPWN_PATH)/overlay"
BR2_ROOTFS_POST_BUILD_SCRIPT="$(BR2_EXTERNAL_PPPWN_PATH)/scripts/post-build.sh"
BR2_ROOTFS_POST_IMAGE_SCRIPT="$(BR2_EXTERNAL_PPPWN_PATH)/scripts/post-image.sh"
```

## package/pppwn/Config.in
```kconfig
config BR2_PACKAGE_PPPWN
    bool "pppwn"
    depends on BR2_USE_MMU
    help
      PPPwn is a kernel remote code execution exploit for the PS4
      that leverages a vulnerability in the FreeBSD network drivers.
      
      https://github.com/xfangfang/PPPwn_cpp
```
